## decompiler/crates/kuna-cli/tests/fixtures/archive_inputs/fit.its
```
/dts-v1/;
/ {
    description = "kuna FIT fixture";
    #address-cells = <1>;
    images {
        kernel-1 {
            description = "flat arm64 code";
            data = /incbin/("kern.bin.gz");
            type = "kernel";
            arch = "arm64";
            os = "linux";
            compression = "gzip";
            load = <0x80080000>;
            entry = <0x8008000c>;
            hash-1 { algo = "crc32"; };
        };
        fdt-1 {
            description = "device tree";
            data = /incbin/("board.dtb");
            type = "flat_dt";
            arch = "arm64";
            compression = "none";
        };
    };
    configurations {
        default = "conf-1";
        conf-1 { kernel = "kernel-1"; fdt = "fdt-1"; };
    };
};
```
