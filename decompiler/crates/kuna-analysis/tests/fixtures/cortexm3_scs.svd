# MINI_SCS register map
Registers are 32-bit, access not given, no defined reset value unless marked. A register's access mark holds for its fields unless they carry their own. Offsets are from the block's base; lines under a group give offsets from that group; [hi:lo] are bit positions; {n}, {i} and the like mark numbered series; 'fields as' and 'values as' point back to an identical list; <NAME> marks a mode.

## Memory map
0xE000E010 STK
0xE000ED00 SCB
0xE000ED88 FPU_CPACR

## SCB
Base 0xE000ED00
0x00 CPUID
0x04 ICSR
0x08 VTOR
0x0C AIRCR

## FPU_CPACR
Base 0xE000ED88
0x00 CPACR

## STK
Base 0xE000E010
0x00 CSR
0x04 RVR
0x08 CVR
